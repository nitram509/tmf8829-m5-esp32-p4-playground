## main/Kconfig.projbuild
```kconfig
menu "TMF8829 UDP Forwarder Configuration"

    config TMF8829_SPI_HOST
        int "SPI host (2 = SPI2_HOST, 3 = SPI3_HOST)"
        range 2 3
        default 2

    config TMF8829_SPI_CLOCK_HZ
        int "TMF8829 SPI clock [Hz]"
        range 100000 20000000
        default 20000000

    config TMF8829_PIN_MOSI
        int "SPI MOSI GPIO"
        default 13

    config TMF8829_PIN_MISO
        int "SPI MISO GPIO"
        default 11

    config TMF8829_PIN_SCLK
        int "SPI SCLK GPIO"
        default 12

    config TMF8829_PIN_CS
        int "TMF8829 CS GPIO"
        default 10

    config TMF8829_PIN_DE
        int "TMF8829 DE GPIO"
        default 9

    config TMF8829_READ_PERIOD_MS
        int "Sensor read period [ms]"
        range 10 5000
        default 100

    config TMF8829_UDP_TARGET_HOST
        string "UDP target host/IP"
        default "192.168.1.100"

    config TMF8829_UDP_TARGET_PORT
        int "UDP target port"
        range 1 65535
        default 5005

    config TMF8829_LOG_SENSOR_DATA
        bool "Log parsed sensor sample to app log"
        default y

endmenu
```
