#include "web_server.h"
#include "image.h"
#include "image_png.h"
#include "app.h"
#include "help.h"

#include <cstdlib>
#include <cstring>
#include <cstdio>

#include "esp_log.h"
#include "esp_http_server.h"
#include "esp_timer.h"
#include "esp_mac.h"
#include "esp_chip_info.h"

static const char *TAG = "web_server";

static httpd_handle_t s_server = nullptr;

// Embedded web assets generated by ESP-IDF EMBED_TXTFILES
extern const uint8_t index_html_start[] asm("_binary_index_html_start");
extern const uint8_t index_html_end[]   asm("_binary_index_html_end");

extern const uint8_t pure_min_css_start[] asm("_binary_pure_min_css_start");
extern const uint8_t pure_min_css_end[]   asm("_binary_pure_min_css_end");

extern const uint8_t grids_responsive_min_css_start[] asm("_binary_grids_responsive_min_css_start");
extern const uint8_t grids_responsive_min_css_end[]   asm("_binary_grids_responsive_min_css_end");

extern const uint8_t styles_css_start[] asm("_binary_styles_css_start");
extern const uint8_t styles_css_end[]   asm("_binary_styles_css_end");

static esp_err_t index_get_handler(httpd_req_t *req) {
    const size_t length = index_html_end - index_html_start;
    httpd_resp_set_type(req, "text/html");
    return httpd_resp_send(req, reinterpret_cast<const char *>(index_html_start), length);
}

static esp_err_t pure_min_css_get_handler(httpd_req_t *req) {
    const size_t length = pure_min_css_end - pure_min_css_start;
    httpd_resp_set_type(req, "text/css");
    return httpd_resp_send(req, reinterpret_cast<const char *>(pure_min_css_start), length);
}

static esp_err_t grids_responsive_min_css_get_handler(httpd_req_t *req) {
    const size_t length = grids_responsive_min_css_end - grids_responsive_min_css_start;
    httpd_resp_set_type(req, "text/css");
    return httpd_resp_send(req, reinterpret_cast<const char *>(grids_responsive_min_css_start), length);
}

static esp_err_t styles_css_get_handler(httpd_req_t *req) {
    const size_t length = styles_css_end - styles_css_start;
    httpd_resp_set_type(req, "text/css");
    return httpd_resp_send(req, reinterpret_cast<const char *>(styles_css_start), length);
}

static esp_err_t image_png_get_handler(httpd_req_t *req) {
    if (stateTmf8829 == TMF8829_STATE_DISABLED || stateTmf8829 == TMF8829_STATE_ERROR) {
        ESP_LOGW(TAG, "Sensor is not initialized or in error state (state=%d)", stateTmf8829);
        httpd_resp_send_err(req, HTTPD_500_INTERNAL_SERVER_ERROR, "Sensor not initialized or in error state");
        return ESP_FAIL;
    }

    // If sensor is in STOPPED state, start continuous measurement automatically
    if (stateTmf8829 == TMF8829_STATE_STOPPED) {
        int8_t cmd = (currentMeasConfigNr >= 0 && currentMeasConfigNr < NR_OF_MEAS_CFGS)
                     ? static_cast<int8_t>(measConfig[currentMeasConfigNr])
                     : static_cast<int8_t>(TMF8829_CMD_STAT__cmd_stat__CMD_LOAD_CFG_48X32);
        preconfigure(cmd);
        measure();
    }

    static uint16_t distances[1536];
    uint16_t width = 0;
    uint16_t height = 0;
    int64_t frame_timestamp_us = 0;
    uint32_t frame_counter = 0;

    bool success = get_latest_distance_map(distances, &width, &height, &frame_timestamp_us, &frame_counter);
    if (!success) {
        // Wait up to 300 ms for first background frame if just started
        int retry = 0;
        while (!success && retry < 30) {
            vTaskDelay(pdMS_TO_TICKS(10));
            success = get_latest_distance_map(distances, &width, &height, &frame_timestamp_us, &frame_counter);
            retry++;
        }
    }

    if (!success || width == 0 || height == 0) {
        ESP_LOGE(TAG, "No depth frame available from background stream");
        httpd_resp_send_err(req, HTTPD_500_INTERNAL_SERVER_ERROR, "Sensor measurement in progress, first frame not ready");
        return ESP_FAIL;
    }

    static uint8_t png_buffer[4096];
    const size_t png_size = encode_gray16_png(distances, width, height, png_buffer, sizeof(png_buffer));

    if (png_size == 0) {
        ESP_LOGE(TAG, "Failed to encode PNG image (%ux%u)", width, height);
        httpd_resp_send_err(req, HTTPD_500_INTERNAL_SERVER_ERROR, "Failed to encode PNG image");
        return ESP_FAIL;
    }

    httpd_resp_set_type(req, "image/png");
    return httpd_resp_send(req, reinterpret_cast<const char *>(png_buffer), png_size);
}

static esp_err_t image_snr_png_get_handler(httpd_req_t *req) {
    if (stateTmf8829 == TMF8829_STATE_DISABLED || stateTmf8829 == TMF8829_STATE_ERROR) {
        ESP_LOGW(TAG, "Sensor is not initialized or in error state (state=%d)", stateTmf8829);
        httpd_resp_send_err(req, HTTPD_500_INTERNAL_SERVER_ERROR, "Sensor not initialized or in error state");
        return ESP_FAIL;
    }

    // If sensor is in STOPPED state, start continuous measurement automatically
    if (stateTmf8829 == TMF8829_STATE_STOPPED) {
        int8_t cmd = (currentMeasConfigNr >= 0 && currentMeasConfigNr < NR_OF_MEAS_CFGS)
                     ? static_cast<int8_t>(measConfig[currentMeasConfigNr])
                     : static_cast<int8_t>(TMF8829_CMD_STAT__cmd_stat__CMD_LOAD_CFG_48X32);
        preconfigure(cmd);
        measure();
    }

    static uint8_t snr_map[1536];
    uint16_t width = 0;
    uint16_t height = 0;
    int64_t frame_timestamp_us = 0;
    uint32_t frame_counter = 0;

    bool success = get_latest_snr_map(snr_map, &width, &height, &frame_timestamp_us, &frame_counter);
    if (!success) {
        // Wait up to 300 ms for first background frame if just started
        int retry = 0;
        while (!success && retry < 30) {
            vTaskDelay(pdMS_TO_TICKS(10));
            success = get_latest_snr_map(snr_map, &width, &height, &frame_timestamp_us, &frame_counter);
            retry++;
        }
    }

    if (!success || width == 0 || height == 0) {
        ESP_LOGE(TAG, "No SNR frame available from background stream");
        httpd_resp_send_err(req, HTTPD_500_INTERNAL_SERVER_ERROR, "Sensor measurement in progress, first frame not ready");
        return ESP_FAIL;
    }

    static uint8_t png_buffer[4096];
    const size_t png_size = encode_gray8_png(snr_map, width, height, png_buffer, sizeof(png_buffer));

    if (png_size == 0) {
        ESP_LOGE(TAG, "Failed to encode SNR PNG image (%ux%u)", width, height);
        httpd_resp_send_err(req, HTTPD_500_INTERNAL_SERVER_ERROR, "Failed to encode PNG image");
        return ESP_FAIL;
    }

    httpd_resp_set_type(req, "image/png");
    return httpd_resp_send(req, reinterpret_cast<const char *>(png_buffer), png_size);
}

static esp_err_t config_get_handler(httpd_req_t *req) {
    if (stateTmf8829 == TMF8829_STATE_DISABLED || stateTmf8829 == TMF8829_STATE_ERROR) {
        httpd_resp_send_err(req, HTTPD_500_INTERNAL_SERVER_ERROR, "Sensor not initialized or in error state");
        return ESP_FAIL;
    }

    uint8_t cfgCmd = (currentMeasConfigNr >= 0 && currentMeasConfigNr < NR_OF_MEAS_CFGS)
                     ? static_cast<uint8_t>(measConfig[currentMeasConfigNr])
                     : static_cast<uint8_t>(TMF8829_CMD_STAT__cmd_stat__CMD_LOAD_CFG_48X32);

    uint16_t period = static_cast<uint16_t>(tmf8829.config[TMF8829_CFG_PERIOD_MS_LSB - TMF8829_CFG_PERIOD_MS_LSB])
                      | (static_cast<uint16_t>(tmf8829.config[TMF8829_CFG_PERIOD_MS_MSB - TMF8829_CFG_PERIOD_MS_LSB]) << 8);
    uint16_t kiloIter = static_cast<uint16_t>(tmf8829.config[TMF8829_CFG_KILO_ITERATIONS_LSB - TMF8829_CFG_PERIOD_MS_LSB])
                        | (static_cast<uint16_t>(tmf8829.config[TMF8829_CFG_KILO_ITERATIONS_MSB - TMF8829_CFG_PERIOD_MS_LSB]) << 8);
    uint8_t fpMode = tmf8829.config[TMF8829_CFG_FP_MODE - TMF8829_CFG_PERIOD_MS_LSB];
    uint8_t dualMode = tmf8829.config[TMF8829_CFG_ENABLE_DUAL_MODE - TMF8829_CFG_PERIOD_MS_LSB] & 0x03;
    uint8_t nrPeaks = tmf8829.config[TMF8829_CFG_RESULT_FORMAT - TMF8829_CFG_PERIOD_MS_LSB] & TMF8829_CFG_RESULT_FORMAT_NR_PEAKS_MASK;
    if (nrPeaks == 0) nrPeaks = 1;

    const char *stateStr = (stateTmf8829 == TMF8829_STATE_MEASURE) ? "MEASURE" :
                           (stateTmf8829 == TMF8829_STATE_STOPPED) ? "STOPPED" :
                           (stateTmf8829 == TMF8829_STATE_STANDBY) ? "STANDBY" : "UNKNOWN";

    char json[1024];
    int len = snprintf(json, sizeof(json),
        "{\n"
        "  \"mode_cmd\": \"0x%02X\",\n"
        "  \"mode_name\": \"%s\",\n"
        "  \"fp_mode\": %u,\n"
        "  \"fp_mode_name\": \"%s\",\n"
        "  \"period_ms\": %u,\n"
        "  \"kilo_iterations\": %u,\n"
        "  \"dual_mode\": %u,\n"
        "  \"nr_peaks\": %u,\n"
        "  \"state\": \"%s\",\n"
        "  \"modes\": [\n"
        "    {\"cmd\": \"0x40\", \"name\": \"8x8 Default\"},\n"
        "    {\"cmd\": \"0x41\", \"name\": \"8x8 Long Range (12m)\"},\n"
        "    {\"cmd\": \"0x42\", \"name\": \"8x8 High Accuracy (Short Range)\"},\n"
        "    {\"cmd\": \"0x43\", \"name\": \"16x16 Default\"},\n"
        "    {\"cmd\": \"0x44\", \"name\": \"16x16 High Accuracy (Short Range)\"},\n"
        "    {\"cmd\": \"0x45\", \"name\": \"32x32 Default\"},\n"
        "    {\"cmd\": \"0x46\", \"name\": \"32x32 High Accuracy (Short Range)\"},\n"
        "    {\"cmd\": \"0x47\", \"name\": \"48x32 Default\"},\n"
        "    {\"cmd\": \"0x48\", \"name\": \"48x32 High Accuracy (Short Range)\"}\n"
        "  ]\n"
        "}\n",
        cfgCmd,
        getPreconfigName(cfgCmd),
        fpMode,
        getFpModeName(fpMode),
        period,
        kiloIter,
        dualMode,
        nrPeaks,
        stateStr
    );

    httpd_resp_set_type(req, "application/json");
    return httpd_resp_send(req, json, len);
}

static esp_err_t config_post_handler(httpd_req_t *req) {
    if (stateTmf8829 == TMF8829_STATE_DISABLED || stateTmf8829 == TMF8829_STATE_ERROR) {
        httpd_resp_send_err(req, HTTPD_500_INTERNAL_SERVER_ERROR, "Sensor not initialized or in error state");
        return ESP_FAIL;
    }

    char buf[512];
    int remaining = req->content_len;
    if (remaining <= 0 || remaining >= sizeof(buf)) {
        httpd_resp_send_err(req, HTTPD_400_BAD_REQUEST, "Invalid content length");
        return ESP_FAIL;
    }

    int received = httpd_req_recv(req, buf, remaining);
    if (received <= 0) {
        if (received == HTTPD_SOCK_ERR_TIMEOUT) {
            httpd_resp_send_408(req);
        }
        return ESP_FAIL;
    }
    buf[received] = '\0';

    ESP_LOGI(TAG, "POST /api/config payload: %s", buf);

    uint8_t selectedCmd = 0;
    uint16_t kiter = 0;
    uint16_t period_ms = 0;
    uint8_t dual_mode = 0;
    uint8_t nr_peaks = 1;

    char val_str[32] = {0};

    // Try parsing urlencoded fields
    if (httpd_query_key_value(buf, "mode", val_str, sizeof(val_str)) == ESP_OK ||
        httpd_query_key_value(buf, "cmd", val_str, sizeof(val_str)) == ESP_OK) {
        selectedCmd = static_cast<uint8_t>(strtol(val_str, nullptr, 0));
    }
    if (httpd_query_key_value(buf, "kiter", val_str, sizeof(val_str)) == ESP_OK ||
        httpd_query_key_value(buf, "kilo_iterations", val_str, sizeof(val_str)) == ESP_OK) {
        kiter = static_cast<uint16_t>(strtol(val_str, nullptr, 0));
    }
    if (httpd_query_key_value(buf, "period_ms", val_str, sizeof(val_str)) == ESP_OK ||
        httpd_query_key_value(buf, "period", val_str, sizeof(val_str)) == ESP_OK) {
        period_ms = static_cast<uint16_t>(strtol(val_str, nullptr, 0));
    }
    if (httpd_query_key_value(buf, "dual_mode", val_str, sizeof(val_str)) == ESP_OK) {
        dual_mode = static_cast<uint8_t>(strtol(val_str, nullptr, 0));
    }
    if (httpd_query_key_value(buf, "nr_peaks", val_str, sizeof(val_str)) == ESP_OK ||
        httpd_query_key_value(buf, "peaks", val_str, sizeof(val_str)) == ESP_OK) {
        nr_peaks = static_cast<uint8_t>(strtol(val_str, nullptr, 0));
    }

    // JSON format support
    if (buf[0] == '{') {
        char *p = strstr(buf, "\"mode\"");
        if (!p) p = strstr(buf, "\"cmd\"");
        if (p) {
            p = strchr(p, ':');
            if (p) selectedCmd = static_cast<uint8_t>(strtol(p + 1, nullptr, 0));
        }
        p = strstr(buf, "\"kiter\"");
        if (!p) p = strstr(buf, "\"kilo_iterations\"");
        if (p) {
            p = strchr(p, ':');
            if (p) kiter = static_cast<uint16_t>(strtol(p + 1, nullptr, 0));
        }
        p = strstr(buf, "\"period_ms\"");
        if (!p) p = strstr(buf, "\"period\"");
        if (p) {
            p = strchr(p, ':');
            if (p) period_ms = static_cast<uint16_t>(strtol(p + 1, nullptr, 0));
        }
        p = strstr(buf, "\"dual_mode\"");
        if (p) {
            p = strchr(p, ':');
            if (p) dual_mode = static_cast<uint8_t>(strtol(p + 1, nullptr, 0));
        }
        p = strstr(buf, "\"nr_peaks\"");
        if (!p) p = strstr(buf, "\"peaks\"");
        if (p) {
            p = strchr(p, ':');
            if (p) nr_peaks = static_cast<uint8_t>(strtol(p + 1, nullptr, 0));
        }
    }

    // Default to current mode if not specified or raw value passed
    if (selectedCmd == 0) {
        if (buf[0] >= '0' && buf[0] <= '9') {
            selectedCmd = static_cast<uint8_t>(strtol(buf, nullptr, 0));
        } else {
            selectedCmd = (currentMeasConfigNr >= 0 && currentMeasConfigNr < NR_OF_MEAS_CFGS)
                          ? static_cast<uint8_t>(measConfig[currentMeasConfigNr])
                          : static_cast<uint8_t>(TMF8829_CMD_STAT__cmd_stat__CMD_LOAD_CFG_48X32);
        }
    }

    // Validate mode command
    bool valid = false;
    for (int i = 0; i < NR_OF_MEAS_CFGS; i++) {
        if (measConfig[i] == selectedCmd) {
            valid = true;
            break;
        }
    }

    if (!valid) {
        ESP_LOGW(TAG, "Invalid configuration command received: 0x%02X", selectedCmd);
        httpd_resp_send_err(req, HTTPD_400_BAD_REQUEST, "Invalid mode command. Must be 0x40..0x48");
        return ESP_FAIL;
    }

    if (nr_peaks < 1 || nr_peaks > 4) {
        nr_peaks = 1;
    }

    // Enforce 8x8 mode constraint for Dual Mode 2 (11m Long Range)
    if (dual_mode == 2) {
        if (selectedCmd != TMF8829_CMD_STAT__cmd_stat__CMD_LOAD_CFG_8X8 &&
            selectedCmd != TMF8829_CMD_STAT__cmd_stat__CMD_LOAD_CFG_8X8_LONG_RANGE &&
            selectedCmd != TMF8829_CMD_STAT__cmd_stat__CMD_LOAD_CFG_8X8_HIGH_ACCURACY) {
            ESP_LOGI(TAG, "Dual Mode 2 is exclusive to 8x8 modes; adjusting mode from 0x%02X to 0x%02X (%s)",
                     selectedCmd, TMF8829_CMD_STAT__cmd_stat__CMD_LOAD_CFG_8X8_LONG_RANGE,
                     getPreconfigName(TMF8829_CMD_STAT__cmd_stat__CMD_LOAD_CFG_8X8_LONG_RANGE));
            selectedCmd = TMF8829_CMD_STAT__cmd_stat__CMD_LOAD_CFG_8X8_LONG_RANGE;
        }
    }

    SensorConfigParams params = {
        .modeCmd = selectedCmd,
        .kiloIterations = kiter,
        .periodMs = period_ms,
        .dualMode = dual_mode,
        .nrPeaks = nr_peaks
    };

    ESP_LOGI(TAG, "Applying sensor config: mode=0x%02X (%s), kiter=%u, period=%u ms, dual=%u, peaks=%u",
             selectedCmd, getPreconfigName(selectedCmd), kiter, period_ms, dual_mode, nr_peaks);

    if (!apply_and_reset_sensor_config(params)) {
        httpd_resp_send_err(req, HTTPD_500_INTERNAL_SERVER_ERROR, "Failed to apply sensor configuration");
        return ESP_FAIL;
    }

    // Check Accept header to decide between 303 redirect and JSON response
    char accept_hdr[128] = {0};
    esp_err_t hdr_err = httpd_req_get_hdr_value_str(req, "Accept", accept_hdr, sizeof(accept_hdr));
    if ((hdr_err == ESP_OK || hdr_err == ESP_ERR_HTTPD_RESULT_TRUNC) &&
        strstr(accept_hdr, "application/json") != nullptr) {
        char resp_json[256];
        int resp_len = snprintf(resp_json, sizeof(resp_json),
                                "{\"status\":\"ok\",\"mode\":\"0x%02X\",\"mode_name\":\"%s\",\"kilo_iterations\":%u,\"period_ms\":%u,\"dual_mode\":%u,\"nr_peaks\":%u}\n",
                                selectedCmd, getPreconfigName(selectedCmd), kiter, period_ms, dual_mode, nr_peaks);
        httpd_resp_set_type(req, "application/json");
        return httpd_resp_send(req, resp_json, resp_len);
    }

    // Regular HTTP POST form submission: redirect back to home dashboard
    httpd_resp_set_status(req, "303 See Other");
    httpd_resp_set_hdr(req, "Location", "/");
    return httpd_resp_send(req, nullptr, 0);
}

static esp_err_t telemetry_get_handler(httpd_req_t *req) {
    int8_t temp0 = 0, temp1 = 0, temp2 = 0;
    float fps = 0.0f;
    uint16_t width = 0, height = 0;
    uint32_t frame_counter = 0;

    get_sensor_telemetry(&temp0, &temp1, &temp2, &fps, &width, &height, &frame_counter);

    const char *stateStr = (stateTmf8829 == TMF8829_STATE_MEASURE) ? "MEASURE" :
                           (stateTmf8829 == TMF8829_STATE_STOPPED) ? "STOPPED" :
                           (stateTmf8829 == TMF8829_STATE_STANDBY) ? "STANDBY" : "UNKNOWN";

    char json[256];
    int len = snprintf(json, sizeof(json),
        "{\n"
        "  \"temp0\": %d,\n"
        "  \"temp1\": %d,\n"
        "  \"temp2\": %d,\n"
        "  \"fps\": %.1f,\n"
        "  \"width\": %u,\n"
        "  \"height\": %u,\n"
        "  \"frame_counter\": %lu,\n"
        "  \"state\": \"%s\"\n"
        "}\n",
        temp0, temp1, temp2, fps, width, height, static_cast<unsigned long>(frame_counter), stateStr
    );

    httpd_resp_set_type(req, "application/json");
    return httpd_resp_send(req, json, len);
}

static esp_err_t info_get_handler(httpd_req_t *req) {
    char chip_ver[32] = {};
    snprintf(chip_ver, sizeof(chip_ver), "%u.%u",
             tmf8829.device.chipVersion[0],
             tmf8829.device.chipVersion[1]);

    char sensor_serial[32] = {};
    snprintf(sensor_serial, sizeof(sensor_serial), "0x%08lX",
             static_cast<unsigned long>(tmf8829.device.deviceSerialNumber));

    uint8_t esp_mac[6] = {};
    if (const esp_err_t mac_err = esp_efuse_mac_get_default(esp_mac); mac_err != ESP_OK) {
        esp_read_mac(esp_mac, ESP_MAC_ETH);
    }

    char esp_serial[32] = {};
    snprintf(esp_serial, sizeof(esp_serial), "%02X:%02X:%02X:%02X:%02X:%02X",
             esp_mac[0], esp_mac[1], esp_mac[2], esp_mac[3], esp_mac[4], esp_mac[5]);

    char json[512];
    const int len = snprintf(json, sizeof(json),
        "{\n"
        "  \"sensor_chip_version\": \"%s\",\n"
        "  \"sensor_serial_number\": \"%s\",\n"
        "  \"esp32_serial_number\": \"%s\"\n"
        "}\n",
        chip_ver,
        sensor_serial,
        esp_serial
    );

    httpd_resp_set_type(req, "application/json");
    return httpd_resp_send(req, json, len);
}

static constexpr httpd_uri_t uri_root = {
    .uri       = "/",
    .method    = HTTP_GET,
    .handler   = index_get_handler,
    .user_ctx  = nullptr
};

static constexpr httpd_uri_t uri_index_html = {
    .uri       = "/index.html",
    .method    = HTTP_GET,
    .handler   = index_get_handler,
    .user_ctx  = nullptr
};

static constexpr httpd_uri_t uri_pure_min_css = {
    .uri       = "/pure-min.css",
    .method    = HTTP_GET,
    .handler   = pure_min_css_get_handler,
    .user_ctx  = nullptr
};

static constexpr httpd_uri_t uri_grids_responsive_min_css = {
    .uri       = "/grids-responsive-min.css",
    .method    = HTTP_GET,
    .handler   = grids_responsive_min_css_get_handler,
    .user_ctx  = nullptr
};

static constexpr httpd_uri_t uri_styles_css = {
    .uri       = "/styles.css",
    .method    = HTTP_GET,
    .handler   = styles_css_get_handler,
    .user_ctx  = nullptr
};

static constexpr httpd_uri_t uri_api_image_depth_png = {
    .uri       = "/api/image/depth.png",
    .method    = HTTP_GET,
    .handler   = image_png_get_handler,
    .user_ctx  = nullptr
};

static constexpr httpd_uri_t uri_api_image_snr_png = {
    .uri       = "/api/image/snr.png",
    .method    = HTTP_GET,
    .handler   = image_snr_png_get_handler,
    .user_ctx  = nullptr
};

static constexpr httpd_uri_t uri_api_config_get = {
    .uri       = "/api/config",
    .method    = HTTP_GET,
    .handler   = config_get_handler,
    .user_ctx  = nullptr
};

static constexpr httpd_uri_t uri_api_config_post = {
    .uri       = "/api/config",
    .method    = HTTP_POST,
    .handler   = config_post_handler,
    .user_ctx  = nullptr
};

static constexpr httpd_uri_t uri_api_telemetry_get = {
    .uri       = "/api/telemetry",
    .method    = HTTP_GET,
    .handler   = telemetry_get_handler,
    .user_ctx  = nullptr
};

static constexpr httpd_uri_t uri_api_status_get = {
    .uri       = "/api/status",
    .method    = HTTP_GET,
    .handler   = telemetry_get_handler,
    .user_ctx  = nullptr
};

static constexpr httpd_uri_t uri_api_info_get = {
    .uri       = "/api/info",
    .method    = HTTP_GET,
    .handler   = info_get_handler,
    .user_ctx  = nullptr
};

esp_err_t start_webserver() {
    if (s_server != nullptr) {
        return ESP_OK;
    }

    httpd_config_t config = HTTPD_DEFAULT_CONFIG();
    config.max_uri_handlers = 16;
    config.lru_purge_enable = true;

    ESP_LOGI(TAG, "Starting HTTP server on port %d (max URI handlers: %u)...", config.server_port, config.max_uri_handlers);
    esp_err_t ret = httpd_start(&s_server, &config);
    if (ret != ESP_OK) {
        ESP_LOGE(TAG, "Failed to start HTTP server: %s", esp_err_to_name(ret));
        return ret;
    }

    const httpd_uri_t *handlers[] = {
        &uri_root,
        &uri_index_html,
        &uri_pure_min_css,
        &uri_grids_responsive_min_css,
        &uri_styles_css,
        &uri_api_image_depth_png,
        &uri_api_image_snr_png,
        &uri_api_config_get,
        &uri_api_config_post,
        &uri_api_telemetry_get,
        &uri_api_status_get,
        &uri_api_info_get,
    };

    for (const auto *handler : handlers) {
        esp_err_t err = httpd_register_uri_handler(s_server, handler);
        if (err != ESP_OK) {
            ESP_LOGE(TAG, "Failed to register URI %s (method %d): %s", handler->uri, handler->method, esp_err_to_name(err));
        }
    }

    ESP_LOGI(TAG, "HTTP server started and listening for web assets, '/api/config', '/api/image/depth.png', and '/api/image/snr.png'");
    return ESP_OK;
}

void stop_webserver(void) {
    if (s_server != nullptr) {
        ESP_LOGI(TAG, "Stopping HTTP server...");
        httpd_stop(s_server);
        s_server = nullptr;
    }
}
